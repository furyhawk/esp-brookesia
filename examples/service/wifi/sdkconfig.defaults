## hal/brookesia_hal_adaptor/Kconfig
```kconfig
menu "ESP-Brookesia: Hal Adaptor Configurations"
    menuconfig BROOKESIA_HAL_ADAPTOR_ENABLE_DEBUG_LOG
        bool "Enable debug or lower level logs"
        default n

    if BROOKESIA_HAL_ADAPTOR_ENABLE_DEBUG_LOG
        menu "General"
            config BROOKESIA_HAL_ADAPTOR_GENERAL_DEVICE_ENABLE_DEBUG_LOG
                bool "Device"
                default n
                help
                    Enable debug or lower level logs for the general device.

            config BROOKESIA_HAL_ADAPTOR_BOARD_INFO_IMPL_ENABLE_DEBUG_LOG
                bool "Board Info"
                default n
                help
                    Enable debug or lower level logs for the board info implementation.
        endmenu

        menu "Audio"
            config BROOKESIA_HAL_ADAPTOR_AUDIO_DEVICE_ENABLE_DEBUG_LOG
                bool "Device"
                default n
                help
                    Enable debug or lower level logs for the audio device.

            config BROOKESIA_HAL_ADAPTOR_AUDIO_CODEC_PLAYER_IMPL_ENABLE_DEBUG_LOG
                bool "Codec Player"
                default n
                help
                    Enable debug or lower level logs for the audio codec player.

            config BROOKESIA_HAL_ADAPTOR_AUDIO_CODEC_RECORDER_IMPL_ENABLE_DEBUG_LOG
                bool "Codec Recorder"
                default n
                help
                    Enable debug or lower level logs for the audio codec recorder.
        endmenu

        menu "Display"
            config BROOKESIA_HAL_ADAPTOR_DISPLAY_DEVICE_ENABLE_DEBUG_LOG
                bool "Device"
                default n
                help
                    Enable debug or lower level logs for the display device.

            config BROOKESIA_HAL_ADAPTOR_DISPLAY_LEDC_BACKLIGHT_IMPL_ENABLE_DEBUG_LOG
                bool "LEDC Backlight"
                default n
                help
                    Enable debug or lower level logs for the display LEDC backlight.

            config BROOKESIA_HAL_ADAPTOR_DISPLAY_LCD_PANEL_IMPL_ENABLE_DEBUG_LOG
                bool "LCD Panel"
                default n
                help
                    Enable debug or lower level logs for the display LCD panel.

            config BROOKESIA_HAL_ADAPTOR_DISPLAY_LCD_TOUCH_IMPL_ENABLE_DEBUG_LOG
                bool "LCD Touch"
                default n
                help
                    Enable debug or lower level logs for the display LCD touch.
        endmenu

        menu "Storage"
            config BROOKESIA_HAL_ADAPTOR_STORAGE_DEVICE_ENABLE_DEBUG_LOG
                bool "Device"
                default n
                help
                    Enable debug or lower level logs for the storage device.

            config BROOKESIA_HAL_ADAPTOR_STORAGE_GENERAL_FS_ENABLE_DEBUG_LOG
                bool "General FS"
                default n
                help
                    Enable debug or lower level logs for the storage general file system.

            config BROOKESIA_HAL_ADAPTOR_STORAGE_KV_ENABLE_DEBUG_LOG
                bool "KV storage"
                default n
                help
                    Enable debug or lower level logs for the storage key-value implementation.
        endmenu

        menu "Wi-Fi"
            config BROOKESIA_HAL_ADAPTOR_WIFI_DEVICE_ENABLE_DEBUG_LOG
                bool "Device"
                default n
                help
                    Enable debug or lower level logs for the Wi-Fi device.

            config BROOKESIA_HAL_ADAPTOR_WIFI_BACKEND_ENABLE_DEBUG_LOG
                bool "ESP-IDF backend"
                default n
                help
                    Enable debug or lower level logs for the Wi-Fi ESP-IDF backend.
        endmenu

        menu "Power"
            config BROOKESIA_HAL_ADAPTOR_POWER_DEVICE_ENABLE_DEBUG_LOG
                bool "Device"
                default n
                help
                    Enable debug or lower level logs for the power device.

            config BROOKESIA_HAL_ADAPTOR_BATTERY_AXP2101_IMPL_ENABLE_DEBUG_LOG
                bool "Battery AXP2101"
                default n
                help
                    Enable debug or lower level logs for the battery AXP2101.

            config BROOKESIA_HAL_ADAPTOR_BATTERY_ADC_IMPL_ENABLE_DEBUG_LOG
                bool "Battery ADC"
                default n
                help
                    Enable debug or lower level logs for the battery ADC.
        endmenu
    endif

    menuconfig BROOKESIA_HAL_ADAPTOR_ENABLE_GENERAL_DEVICE
        bool "General Device"
        default n
        help
            Enable the general device.

    if BROOKESIA_HAL_ADAPTOR_ENABLE_GENERAL_DEVICE
        menuconfig BROOKESIA_HAL_ADAPTOR_GENERAL_ENABLE_BOARD_INFO_IMPL
            bool "Board Info"
            default n
            help
                Enable the board info.
    endif

    menuconfig BROOKESIA_HAL_ADAPTOR_ENABLE_AUDIO_DEVICE
        bool "Audio Device"
        default n
        help
            Enable the audio codec device.

    if BROOKESIA_HAL_ADAPTOR_ENABLE_AUDIO_DEVICE
        menuconfig BROOKESIA_HAL_ADAPTOR_AUDIO_ENABLE_CODEC_PLAYER_IMPL
            bool "Codec Player"
            depends on ESP_BOARD_DEV_AUDIO_CODEC_SUPPORT
            default n
            help
                Enable the player.

        menuconfig BROOKESIA_HAL_ADAPTOR_AUDIO_ENABLE_CODEC_RECORDER_IMPL
            bool "Codec Recorder"
            depends on ESP_BOARD_DEV_AUDIO_CODEC_SUPPORT
            default n
            help
                Enable the recorder.

        if BROOKESIA_HAL_ADAPTOR_AUDIO_ENABLE_CODEC_RECORDER_IMPL
            config BROOKESIA_HAL_ADAPTOR_AUDIO_CODEC_RECORDER_BITS
                int "Recorder bits"
                default 16
                help
                    The bits of the audio codec device.

            config BROOKESIA_HAL_ADAPTOR_AUDIO_CODEC_RECORDER_CHANNELS
                int "Recorder channels"
                default 1
                help
                    The channels of the audio codec device.

            config BROOKESIA_HAL_ADAPTOR_AUDIO_CODEC_RECORDER_SAMPLE_RATE
                int "Sample rate"
                default 16000
                help
                    The sample rate of the audio codec device.

            config BROOKESIA_HAL_ADAPTOR_AUDIO_CODEC_RECORDER_MIC_LAYOUT
                string "Mic layout"
                default "M"
                help
                    The mic layout of the audio codec device.

            config BROOKESIA_HAL_ADAPTOR_AUDIO_CODEC_RECORDER_GENERAL_GAIN
                string "General gain"
                default "36.0"
                help
                    The general gain of the audio codec device, in dB.

            config BROOKESIA_HAL_ADAPTOR_AUDIO_CODEC_RECORDER_CHANNEL_GAINS
                string "Channel gains"
                default "{\"0\":0.0,\"1\":0.0}"
                help
                    The channel gains of the audio codec device, in dB.
                    JSON format is supported, the key is the channel index, the value is the gain in dB.
        endif
    endif

    menuconfig BROOKESIA_HAL_ADAPTOR_ENABLE_DISPLAY_DEVICE
        bool "Display Device"
        default n
        help
            Enable the display LCD device.

    if BROOKESIA_HAL_ADAPTOR_ENABLE_DISPLAY_DEVICE
        menuconfig BROOKESIA_HAL_ADAPTOR_DISPLAY_ENABLE_LEDC_BACKLIGHT_IMPL
            bool "LEDC Backlight"
            depends on ESP_BOARD_DEV_LEDC_CTRL_SUPPORT
            default n
            help
                Enable the LEDC backlight.

        menuconfig BROOKESIA_HAL_ADAPTOR_DISPLAY_ENABLE_LCD_PANEL_IMPL
            bool "LCD Panel"
            depends on ESP_BOARD_DEV_DISPLAY_LCD_SUPPORT
            default n
            help
                Enable the LCD panel.

        if BROOKESIA_HAL_ADAPTOR_DISPLAY_ENABLE_LCD_PANEL_IMPL
            config BROOKESIA_HAL_ADAPTOR_DISPLAY_LCD_PANEL_H_RES
                int "Horizontal resolution in pixels"
                default 0
                range 0 65535
                help
                    The horizontal resolution of the display LCD panel, in pixels.
                    This value is used to provide the LCD panel resolution information for the CMake stage.

            config BROOKESIA_HAL_ADAPTOR_DISPLAY_LCD_PANEL_V_RES
                int "Vertical resolution in pixels"
                default 0
                range 0 65535
                help
                    The vertical resolution of the display LCD panel, in pixels.
                    This value is used to provide the LCD panel resolution information for the CMake stage.

            config BROOKESIA_HAL_ADAPTOR_DISPLAY_LCD_PANEL_DRAW_X_ALIGN_BYTES
                int "X-axis coordinate alignment bytes"
                default 1
                range 0 16
                help
                    The X-axis coordinate alignment bytes of the display LCD panel.

            config BROOKESIA_HAL_ADAPTOR_DISPLAY_LCD_PANEL_DRAW_Y_ALIGN_BYTES
                int "Y-axis coordinate alignment bytes"
                default 1
                range 0 16
                help
                    The Y-axis coordinate alignment bytes of the display LCD panel.
        endif

        menuconfig BROOKESIA_HAL_ADAPTOR_DISPLAY_ENABLE_LCD_TOUCH_IMPL
            bool "LCD Touch"
            depends on ESP_BOARD_DEV_LCD_TOUCH_I2C_SUPPORT
            default n
            help
                Enable the LCD touch.
    endif

    menuconfig BROOKESIA_HAL_ADAPTOR_ENABLE_STORAGE_DEVICE
        bool "Storage Device"
        default n
        help
            Enable the storage device.

    if BROOKESIA_HAL_ADAPTOR_ENABLE_STORAGE_DEVICE
        menuconfig BROOKESIA_HAL_ADAPTOR_STORAGE_ENABLE_GENERAL_FS_IMPL
            bool "General FS"
            default n
            help
                Enable the storage general file system.

        if BROOKESIA_HAL_ADAPTOR_STORAGE_ENABLE_GENERAL_FS_IMPL
            config BROOKESIA_HAL_ADAPTOR_STORAGE_GENERAL_FS_ENABLE_SPIFFS
                bool "SPIFFS"
                depends on ESP_BOARD_DEV_FS_SPIFFS_SUPPORT
                default n
                help
                    Enable the SPIFFS.

            config BROOKESIA_HAL_ADAPTOR_STORAGE_GENERAL_FS_ENABLE_LITTLEFS
                bool "LittleFS"
                default n
                help
                    Enable the LittleFS.

            if BROOKESIA_HAL_ADAPTOR_STORAGE_GENERAL_FS_ENABLE_LITTLEFS
                config BROOKESIA_HAL_ADAPTOR_STORAGE_GENERAL_FS_LITTLEFS_BASE_PATH
                    string "LittleFS base path"
                    default "/littlefs"
                    help
                        Base path used to mount the LittleFS filesystem.

                config BROOKESIA_HAL_ADAPTOR_STORAGE_GENERAL_FS_LITTLEFS_PARTITION_LABEL
                    string "LittleFS partition label"
                    default "littlefs_data"
                    help
                        Partition label used to mount the LittleFS filesystem.

                config BROOKESIA_HAL_ADAPTOR_STORAGE_GENERAL_FS_LITTLEFS_FORMAT_IF_MOUNT_FAILED
                    bool "Format LittleFS if mount failed"
                    default n
                    help
                        Format the LittleFS partition when mount fails.
            endif

            config BROOKESIA_HAL_ADAPTOR_STORAGE_GENERAL_FS_ENABLE_SDCARD
                bool "SD card (FATFS)"
                depends on ESP_BOARD_DEV_FS_FAT_SUPPORT
                default n
                help
                    Enable the SD card (FATFS).
        endif

        menuconfig BROOKESIA_HAL_ADAPTOR_STORAGE_ENABLE_KV_IMPL
            bool "Key-value storage"
            default n
            help
                Enable the storage key-value implementation backed by ESP-IDF NVS.
    endif

    menuconfig BROOKESIA_HAL_ADAPTOR_ENABLE_POWER_DEVICE
        bool "Power Device"
        default n
        help
            Enable the power device.

    if BROOKESIA_HAL_ADAPTOR_ENABLE_POWER_DEVICE
        menuconfig BROOKESIA_HAL_ADAPTOR_POWER_ENABLE_BATTERY
            bool "Battery"
            default n
            help
                Enable the battery.

        if BROOKESIA_HAL_ADAPTOR_POWER_ENABLE_BATTERY
            choice BROOKESIA_HAL_ADAPTOR_POWER_BATTERY_IMPL_CHOICE
                prompt "Select implementation"
                default BROOKESIA_HAL_ADAPTOR_POWER_BATTERY_IMPL_ADC

                config BROOKESIA_HAL_ADAPTOR_POWER_BATTERY_IMPL_AXP2101
                    bool "AXP2101"
                    help
                        Enable the battery AXP2101.

                config BROOKESIA_HAL_ADAPTOR_POWER_BATTERY_IMPL_ADC
                    bool "ADC"
                    help
                        Enable the battery ADC.
            endchoice

            config BROOKESIA_HAL_ADAPTOR_POWER_BATTERY_LOW_VOLTAGE_MV
                int "Low voltage threshold (mV)"
                default 3500
                range 0 65535
                help
                    Voltage threshold used to report the low battery state.

            config BROOKESIA_HAL_ADAPTOR_POWER_BATTERY_CRITICAL_VOLTAGE_MV
                int "Critical voltage threshold (mV)"
                default 3300
                range 0 65535
                help
                    Voltage threshold used to report the critical battery state.

            if BROOKESIA_HAL_ADAPTOR_POWER_BATTERY_IMPL_ADC
                config BROOKESIA_HAL_ADAPTOR_POWER_BATTERY_ADC_VOLTAGE_SCALE_MUL
                    int "ADC voltage scale multiplier"
                    default 2
                    range 1 65535
                    help
                        Multiplier applied to the calibrated ADC voltage reading.

                config BROOKESIA_HAL_ADAPTOR_POWER_BATTERY_ADC_VOLTAGE_SCALE_DIV
                    int "ADC voltage scale divider"
                    default 1
                    range 1 65535
                    help
                        Divider applied to the calibrated ADC voltage reading.

                config BROOKESIA_HAL_ADAPTOR_POWER_BATTERY_ADC_CHARGE_DETECT_MV
                    int "ADC charge detect voltage threshold (mV)"
                    default 1000
                    range 0 65535
                    help
                        The ADC charge voltage is considered charging when it is at or below this threshold.

                config BROOKESIA_HAL_ADAPTOR_POWER_BATTERY_ADC_SAMPLE_COUNT
                    int "ADC sample count"
                    default 8
                    range 1 1024
                    help
                        Number of ADC raw samples used to calculate the average voltage for each read.

                config BROOKESIA_HAL_ADAPTOR_POWER_BATTERY_ADC_RAW_MAX
                    int "ADC raw maximum value"
                    default 4095
                    range 1 65535
                    help
                        Maximum ADC raw value used by the fallback raw-to-voltage conversion.

                config BROOKESIA_HAL_ADAPTOR_POWER_BATTERY_ADC_REF_VOLTAGE_MV
                    int "ADC fallback reference voltage (mV)"
                    default 3300
                    range 1 65535
                    help
                        Reference voltage used by the fallback raw-to-voltage conversion when calibration is unavailable.

                config BROOKESIA_HAL_ADAPTOR_POWER_BATTERY_ADC_PERCENTAGE_VOLTAGE_MIN_MV
                    int "ADC percentage minimum voltage (mV)"
                    default 3300
                    range 0 65535
                    help
                        Battery voltage mapped to 0 percent when estimating the battery percentage from ADC voltage.

                config BROOKESIA_HAL_ADAPTOR_POWER_BATTERY_ADC_PERCENTAGE_VOLTAGE_MAX_MV
                    int "ADC percentage maximum voltage (mV)"
                    default 4200
                    range 0 65535
                    help
                        Battery voltage mapped to 100 percent when estimating the battery percentage from ADC voltage.
            endif
        endif
    endif

    menuconfig BROOKESIA_HAL_ADAPTOR_ENABLE_WIFI_DEVICE
        bool "Wi-Fi Device"
        default n
        help
            Enable the ESP-IDF Wi-Fi device and its Basic, STA, and SoftAP HAL interfaces.

    if BROOKESIA_HAL_ADAPTOR_ENABLE_WIFI_DEVICE
        menu "SoftAP"
            config BROOKESIA_HAL_ADAPTOR_WIFI_SOFTAP_CHANNEL_MIN
                int "Minimum channel"
                default 1
                range 1 11
                help
                    Minimum channel considered for SoftAP setup.

            config BROOKESIA_HAL_ADAPTOR_WIFI_SOFTAP_CHANNEL_MAX
                int "Maximum channel"
                default 11
                range 1 11
                help
                    Maximum channel considered for SoftAP setup.

            config BROOKESIA_HAL_ADAPTOR_WIFI_SOFTAP_CHANNEL_DEFAULT
                int "Default channel"
                default 1
                range 1 11
                help
                    Default SoftAP channel when no channel is specified and setup cannot scan.

            config BROOKESIA_HAL_ADAPTOR_WIFI_SOFTAP_SETUP_INTERVAL_MS
                int "Setup interval (ms)"
                default 1000
                range 100 10000
                help
                    Interval for the SoftAP setup task.

            config BROOKESIA_HAL_ADAPTOR_WIFI_SOFTAP_SETUP_TIMEOUT_MS
                int "Setup timeout (ms)"
                default 300000
                range 1000 600000
                help
                    Timeout in milliseconds for SoftAP setup.

            config BROOKESIA_HAL_ADAPTOR_WIFI_SOFTAP_EVENT_DELAY_MS
                int "Event delay (ms)"
                default 2000
                range 100 10000
                help
                    Delay in milliseconds before reporting a SoftAP event.

            menu "Provision"
                config BROOKESIA_HAL_ADAPTOR_WIFI_SOFTAP_PROVISION_SCAN_START_INTERVAL_MS
                    int "Provision scan start interval (ms)"
                    default 1000
                    range 100 10000
                    help
                        Interval for starting provision scans.

                config BROOKESIA_HAL_ADAPTOR_WIFI_SOFTAP_PROVISION_SCAN_TIMEOUT_MS
                    int "Provision scan timeout (ms)"
                    default 20000
                    range 1000 60000
                    help
                        Timeout in milliseconds while waiting for provision scan results.

                config BROOKESIA_HAL_ADAPTOR_WIFI_SOFTAP_PROVISION_SUCCESS_CLOSE_DELAY_MS
                    int "Provision close after success delay (ms)"
                    default 3000
                    range 100 10000
                    help
                        Delay in milliseconds before closing provision after a successful STA connection.

                menu "DNS Thread"
                    config BROOKESIA_HAL_ADAPTOR_WIFI_SOFTAP_PROVISION_DNS_THREAD_STACK_SIZE
                        int "Stack size"
                        default 4096
                        help
                            Stack size of the provision DNS thread.

                    config BROOKESIA_HAL_ADAPTOR_WIFI_SOFTAP_PROVISION_DNS_THREAD_PRIORITY
                        int "Priority"
                        default 3
                        help
                            Priority of the provision DNS thread.

                    config BROOKESIA_HAL_ADAPTOR_WIFI_SOFTAP_PROVISION_DNS_THREAD_CORE_ID
                        int "Core ID"
                        default -1
                        range -1 1
                        help
                            Core ID of the provision DNS thread. `-1` means the core ID is not specified.
                endmenu
            endmenu
        endmenu
    endif
endmenu
```
